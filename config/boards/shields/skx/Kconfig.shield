## config/boards/shields/skx/Kconfig.shield
```kconfig
# Copyright (c) 2022 The ZMK Contributors
# SPDX-License-Identifier: MIT

config SHIELD_SKX_LEFT
	def_bool $(shields_list_contains,skx_left)

config SHIELD_SKX_RIGHT
	def_bool $(shields_list_contains,skx_right)
```
